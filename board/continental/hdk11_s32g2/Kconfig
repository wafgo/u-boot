## board/continental/hdk11_s32g2/Kconfig
```kconfig
config SYS_VENDOR
	string
	default "continental"

if TARGET_HDK11_S32G2
	
config SYS_CONFIG_NAME
	default "hdk11_s32g2"

config SYS_BOARD
	default "hdk11_s32g2"

config NR_DRAM_BANKS
	default 2

config ENV_SECT_SIZE
	default 0x10000 if QSPI_BOOT

config SYS_EEPROM_PAGE_WRITE_DELAY_MS
	default 10

config SYS_EEPROM_SIZE
	default 128

endif
```

## configs/continental_hdk11_defconfig
```kconfig
CONFIG_ARM=y
CONFIG_ARCH_S32G2=y
CONFIG_BOARD_EARLY_INIT_F=y

CONFIG_TARGET_HDK11_S32G2=y
CONFIG_QSPI_BOOT=y
CONFIG_GPIO_HOG=y
CONFIG_USB_ULPI_VIEWPORT=y
CONFIG_DM_PCA953X=y
```
